## CMakeLists.txt
```
cmake_minimum_required(VERSION 3.20.0)

set( CMAKE_EXPORT_COMPILE_COMMANDS ON )

find_package(Zephyr REQUIRED HINTS $ENV{ZEPHYR_BASE})
project(picotest)

target_sources(app PRIVATE src/main.c)
```

## west.yml
```
manifest:
  remotes:
    - name: zephyrproject-rtos
      url-base: https://github.com/zephyrproject-rtos

  projects:
    - name: zephyr
      remote: zephyrproject-rtos
      repo-path: zephyr
      clone-depth: 1
      revision: main
      import: true
      path: zephyr

  self:
    path: test_picolib
```

## prj.conf
```kconfig
CONFIG_STDOUT_CONSOLE=y
CONFIG_PRINTK=y
CONFIG_INIT_STACKS=y
CONFIG_MAIN_STACK_SIZE=2048
CONFIG_HEAP_MEM_POOL_SIZE=2048
CONFIG_LOG=y
CONFIG_LOG_MODE_MINIMAL=y

CONFIG_POSIX_API=y
CONFIG_PICOLIBC=y

# para la esp-wrover-kit
CONFIG_ESP_SPIRAM=y
CONFIG_ESP_SPIRAM_HEAP_SIZE=4194304
CONFIG_ESP_HEAP_SEARCH_ALL_REGIONS=n
CONFIG_ESP_HEAP_MIN_EXTRAM_THRESHOLD=8192
CONFIG_SPIRAM_TYPE_ESPPSRAM64=y
CONFIG_HEAP_MEM_POOL_SIZE=32768
CONFIG_COMMON_LIBC_MALLOC_ARENA_SIZE=32768
CONFIG_SYS_HEAP_BIG_ONLY=y
```

## src/main.c
```c
#include <stdlib.h>
#include <stdio.h>
#include <string.h>

int main(void)
{
	char *ptr;
	int i;


	for (i = 0; i < 10; i++) {
		size_t s = 2 << (10 + i);
		printf("Allocating %lld bytes on heap...", (long long) s);

		ptr = malloc(s);
		if (!ptr) {
			perror("malloc");
			return EXIT_FAILURE;
		}
		printf("done!\n");

		printf("Seting the buffer to 0...");
		memset(ptr, 0, s);
		printf("done!\n");

		printf("Freeing the memory...");
		free(ptr);
		printf("done!\n");
	}

	return 0;
}
```
